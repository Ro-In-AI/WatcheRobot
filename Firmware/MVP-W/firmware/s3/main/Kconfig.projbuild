## Firmware/MVP-W/firmware/s3/main/Kconfig.projbuild
```kconfig
menu "Wake Word Configuration"

config ENABLE_WAKE_WORD
    bool "Enable Wake Word Detection"
    default n
    depends on IDF_TARGET_ESP32S3 && SPIRAM
    help
        Enable offline wake word detection using ESP-SR.
        This requires PSRAM and is only supported on ESP32-S3.

        When enabled, the device can be triggered by saying the wake word
        instead of pressing the button.

choice WAKE_WORD_TYPE
    prompt "Wake Word Model"
    default WAKE_WORD_NIHAOXIAOZHI
    depends on ENABLE_WAKE_WORD

    config WAKE_WORD_NIHAOXIAOZHI
        bool "Ni Hao Xiao Zhi (你好小智)"
        help
            Use the built-in "你好小智" wake word model.

    config WAKE_WORD_CUSTOM
        bool "Custom Wake Word (Multinet)"
        help
            Use a custom wake word defined by pinyin.
endchoice

config CUSTOM_WAKE_WORD_PHRASE
    string "Custom Wake Word (Pinyin)"
    default "xiao wei xiao wei"
    depends on WAKE_WORD_CUSTOM
    help
        Custom wake word phrase in pinyin format.
        Example: "xiao wei xiao wei" for "小微小微"
        Words should be separated by spaces.

config CUSTOM_WAKE_WORD_THRESHOLD
    int "Custom Wake Word Threshold (%)"
    default 20
    range 1 99
    depends on WAKE_WORD_CUSTOM
    help
        Detection threshold for custom wake word.
        Lower values are more sensitive (more false positives).
        Higher values are less sensitive (may miss detections).
        Default 20 is a good balance.

config WAKE_WORD_DETECTION_TIMEOUT_MS
    int "Recording Timeout after Wake (ms)"
    default 10000
    depends on ENABLE_WAKE_WORD
    help
        Maximum recording duration after wake word detection.
        After this timeout, recording stops automatically.

config VAD_SILENCE_TIMEOUT_MS
    int "VAD Silence Timeout (ms)"
    default 3000
    depends on ENABLE_WAKE_WORD
    help
        Duration of silence before automatically stopping recording.
        After detecting continuous silence for this duration,
        recording will stop automatically.
        Set to 0 to disable VAD-based stopping.

config VAD_RMS_THRESHOLD
    int "VAD RMS Threshold"
    default 100
    depends on ENABLE_WAKE_WORD
    help
        RMS threshold for silence detection.
        Audio frames with RMS below this value are considered silent.
        Lower values = less sensitive (more audio considered as speech).
        Higher values = more sensitive (more audio considered as silence).
        Typical range: 50-500.

config VAD_MIN_SPEECH_MS
    int "VAD Minimum Speech Duration (ms)"
    default 300
    depends on ENABLE_WAKE_WORD
    help
        Minimum speech duration before VAD can trigger stop.
        Prevents premature stopping right after wake word.
        Recording must have at least this much speech content
        before silence timeout can stop it.

endmenu
```
